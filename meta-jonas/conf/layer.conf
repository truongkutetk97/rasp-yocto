## meta-jonas/conf/layer.conf
```bitbake
# We have a conf and classes directory, add to BBPATH
BBPATH .= ":${LAYERDIR}"

# We have recipes-* directories, add to BBFILES
BBFILES += "${LAYERDIR}/recipes-*/*/*.bb \
            ${LAYERDIR}/recipes-*/*/*.bbappend"

BBFILE_COLLECTIONS += "meta-jonas"
BBFILE_PATTERN_meta-jonas = "^${LAYERDIR}/"
BBFILE_PRIORITY_meta-jonas = "6"

LAYERDEPENDS_meta-jonas = "core"
LAYERSERIES_COMPAT_meta-jonas = "kirkstone"
```
